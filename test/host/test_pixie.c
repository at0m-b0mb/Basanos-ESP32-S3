/* Basanos — Pixie Dust.
 *
 * The generator is checked against glibc's published sequence. The recovery is
 * checked by building R-Hash1/R-Hash2 here from the specification, written out
 * independently of pixie.c, and then requiring the cracker to invert it. A
 * cracker tested only against its own hashing function proves nothing except
 * that it is self-consistent.
 *
 * SPDX-License-Identifier: MIT */
#include "harness.h"
#include "basanos/pixie.h"
#include "basanos/wpspin.h"
#include "basanos/rbac.h"

/* The specification's derivation, restated. If this and pixie.c ever disagree,
 * one of them has been edited without the other and the suite says so. */
static void build_hashes(bas_pixie_in_t *in, uint32_t pin8,
                         const uint8_t rs1[16], const uint8_t rs2[16])
{
    char h1[4], h2[4];
    uint16_t first  = (uint16_t)(pin8 / 10000u);
    uint16_t second = (uint16_t)(pin8 % 10000u);
    for (int i = 0; i < 4; i++) {
        h1[3 - i] = (char)('0' + (first  / (i == 0 ? 1 : (i == 1 ? 10 :
                                    (i == 2 ? 100 : 1000)))) % 10);
        h2[3 - i] = (char)('0' + (second / (i == 0 ? 1 : (i == 1 ? 10 :
                                    (i == 2 ? 100 : 1000)))) % 10);
    }

    uint8_t m[32], psk1[16], psk2[16];
    bas_hmac_sha256(in->authkey, 32, h1, 4, m);  memcpy(psk1, m, 16);
    bas_hmac_sha256(in->authkey, 32, h2, 4, m);  memcpy(psk2, m, 16);

    uint8_t buf[16 + 16 + 192 * 2];
    memcpy(buf,            rs1,     16);
    memcpy(buf + 16,       psk1,    16);
    memcpy(buf + 32,       in->pke, 192);
    memcpy(buf + 32 + 192, in->pkr, 192);
    bas_hmac_sha256(in->authkey, 32, buf, sizeof(buf), in->rhash1);

    memcpy(buf,      rs2,  16);
    memcpy(buf + 16, psk2, 16);
    bas_hmac_sha256(in->authkey, 32, buf, sizeof(buf), in->rhash2);
}

static void fill_material(bas_pixie_in_t *in)
{
    memset(in, 0, sizeof(*in));
    for (int i = 0; i < 32;  i++) { in->authkey[i] = (uint8_t)(0xA0 + i); }
    for (int i = 0; i < 192; i++) { in->pke[i] = (uint8_t)(i * 7 + 3);
                                    in->pkr[i] = (uint8_t)(i * 11 + 5); }
    for (int i = 0; i < 16;  i++) { in->enonce[i] = (uint8_t)(i + 1);
                                    in->rnonce[i] = (uint8_t)(0x40 + i); }
}

void suite_pixie(void)
{
    SUITE("pixie: the clock-seeded generator matches glibc exactly");

    /* This sequence is glibc's published output for seed 1. The host libc on
     * a Mac is BSD's generator and produces something else entirely, which is
     * precisely why the vector is hard-coded rather than compared at runtime:
     * the firmwares under attack link glibc, not whatever built this test. */
    bas_glibc_rng_t g;
    bas_glibc_srand(&g, 1);
    CHECK(bas_glibc_rand(&g) == 1804289383u);
    CHECK(bas_glibc_rand(&g) ==  846930886u);
    CHECK(bas_glibc_rand(&g) == 1681692777u);
    CHECK(bas_glibc_rand(&g) == 1714636915u);
    CHECK(bas_glibc_rand(&g) == 1957747793u);

    /* Seed 0 is replaced by 1: the recurrence has a fixed point at zero and
     * would otherwise emit nothing at all. */
    bas_glibc_rng_t z;
    bas_glibc_srand(&z, 0);
    bas_glibc_srand(&g, 1);
    CHECK(bas_glibc_rand(&z) == bas_glibc_rand(&g));

    bas_glibc_srand(NULL, 5);
    CHECK(bas_glibc_rand(NULL) == 0u);

    SUITE("pixie: a seed is identified from the nonce sent in the clear");

    uint8_t nonce[16];
    bas_glibc_srand(&g, 1700000123u);
    bas_glibc_bytes(&g, nonce, sizeof(nonce));
    CHECK(bas_pixie_find_seed(nonce, 1700000100u, 1700000200u) == 1700000123u);
    /* A window that does not contain the seed must return 0, not the nearest
     * value -- a wrong seed yields a wrong secret and a wrong PIN. */
    CHECK(bas_pixie_find_seed(nonce, 1700000200u, 1700000300u) == 0u);
    CHECK(bas_pixie_find_seed(nonce, 100u, 50u) == 0u);
    CHECK(bas_pixie_find_seed(NULL, 0u, 10u) == 0u);

    SUITE("pixie: zero secret nonces surrender the PIN");

    /* Every PIN used below is checksum-legal. An illegal one would never be
     * generated by the second-half search, so a suite built on one would be
     * testing that the cracker fails -- and passing. */
    CHECK(bas_wps_pin_valid(12345670u));
    CHECK(bas_wps_pin_valid(90163531u));
    CHECK(bas_wps_pin_valid(44556679u));
    CHECK(bas_wps_pin_valid(11223344u));
    CHECK(bas_wps_pin_valid(87654325u));

    /* The Ralink/MediaTek case, and the single most common one in the field. */
    static const uint8_t zeros[16] = { 0 };
    bas_pixie_in_t in;
    bas_pixie_out_t out;

    fill_material(&in);
    build_hashes(&in, 12345670u, zeros, zeros);
    bas_pixie_run(&in, &out);
    CHECK(out.found);
    CHECK(out.pin == 12345670u);
    CHECK(out.vuln == BAS_PIXIE_ZERO);
    CHECK(bas_wps_pin_valid(out.pin));

    /* A PIN whose halves are nothing like each other, to be sure neither half
     * is being recovered by accident from the other. */
    fill_material(&in);
    build_hashes(&in, 90163531u, zeros, zeros);
    bas_pixie_run(&in, &out);
    CHECK(out.found);
    CHECK(out.pin == 90163531u);

    SUITE("pixie: a secret that reuses a nonce sent in the clear");

    fill_material(&in);
    build_hashes(&in, 44556679u, in.enonce, in.enonce);
    bas_pixie_run(&in, &out);
    CHECK(out.found);
    CHECK(out.pin == 44556679u);
    CHECK(out.vuln == BAS_PIXIE_ENONCE);

    fill_material(&in);
    build_hashes(&in, 11223344u, in.rnonce, in.rnonce);
    bas_pixie_run(&in, &out);
    CHECK(out.found);
    CHECK(out.pin == 11223344u);
    CHECK(out.vuln == BAS_PIXIE_RNONCE);

    SUITE("pixie: a sound registrar is reported as not vulnerable");

    /* This is the case that must never produce a false positive. An AP that
     * generates its nonces properly has to come back NONE -- a tool that
     * invents a PIN here would have an operator tell a client their router is
     * broken when it is the only thing in the building that is not. */
    static const uint8_t strong1[16] = {
        0x9F, 0x2C, 0x41, 0xD8, 0x0B, 0x77, 0xE3, 0x15,
        0xA6, 0x58, 0xCC, 0x30, 0x94, 0x6B, 0x21, 0xFE
    };
    static const uint8_t strong2[16] = {
        0x3D, 0xE0, 0x87, 0x1A, 0x55, 0xB2, 0x6C, 0xF9,
        0x48, 0x0D, 0x93, 0xA7, 0x2E, 0xD1, 0x64, 0x8B
    };
    fill_material(&in);
    build_hashes(&in, 12345670u, strong1, strong2);
    bas_pixie_run(&in, &out);
    CHECK(!out.found);
    CHECK(out.pin == 0u);
    CHECK(out.vuln == BAS_PIXIE_NONE);
    CHECK(out.tried == 30000u);         /* it really did search all classes */

    /* Half a weakness is not a credential. R-S1 zero but R-S2 sound recovers
     * the first four digits and nothing more, and must not be reported as a
     * recovered PIN. */
    fill_material(&in);
    build_hashes(&in, 12345670u, zeros, strong2);
    bas_pixie_run(&in, &out);
    CHECK(!out.found);
    CHECK(bas_pixie_first_half(&in, zeros) == 1234);
    CHECK(bas_pixie_second_half(&in, zeros, 1234) == -1);

    SUITE("pixie: the halves invert independently");

    fill_material(&in);
    build_hashes(&in, 87654325u, zeros, zeros);
    CHECK(bas_pixie_first_half(&in, zeros)  == 8765);
    CHECK(bas_pixie_second_half(&in, zeros, 8765) == 4325);
    /* Asked with the wrong first half, the second search must fail rather
     * than return something plausible. */
    CHECK(bas_pixie_second_half(&in, zeros, 8766) == -1);

    CHECK(bas_pixie_first_half(NULL, zeros) == -1);
    CHECK(bas_pixie_first_half(&in, NULL) == -1);
    CHECK(bas_pixie_second_half(NULL, zeros, 0) == -1);
    bas_pixie_run(NULL, &out);
    CHECK(!out.found);
    bas_pixie_run(&in, NULL);

    SUITE("pixie: every verdict carries a name and an explanation");

    for (int v = BAS_PIXIE_NONE; v <= BAS_PIXIE_PRNG_TIME; v++) {
        CHECK(bas_pixie_vuln_name((bas_pixie_vuln_t)v)[0]   != '\0');
        CHECK(bas_pixie_vuln_detail((bas_pixie_vuln_t)v)[0] != '\0');
    }
}
